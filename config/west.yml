## config/west.yml
```yaml
manifest:
  remotes:
    - name: 05bmckay
      url-base: https://github.com/05bmckay
  projects:
    - name: zmk
      remote: 05bmckay
      revision: mouse-pr
      import: app/west.yml
  self:
    path: config
```
